## app/boards/arm/waveshare_rp2040_lcd/Kconfig.board
```kconfig
# Copyright (c) 2023 Caspar Friedrich
# SPDX-License-Identifier: Apache-2.0

config BOARD_WAVESHARE_RP2040_LCD
	bool "Raspberry Pi Pico Board"
	depends on SOC_RP2040
```

## app/boards/arm/waveshare_rp2040_lcd/Kconfig.defconfig
```kconfig
# Copyright (c) 2023 Caspar Friedrich
# SPDX-License-Identifier: Apache-2.0

if BOARD_WAVESHARE_RP2040_LCD

config BOARD
	default "waveshare_rp2040_lcd"

config RP2_FLASH_W25Q080
	default y

if I2C_DW

config I2C_DW_CLOCK_SPEED
	default 125

endif #I2C_DW

endif # BOARD_WAVESHARE_RP2040_LCD
```

## app/boards/shields/piantor_mx/Kconfig.defconfig
```kconfig
if SHIELD_PIANTOR_MX_LEFT || SHIELD_PIANTOR_MX_RIGHT

config I2C
    default y

config SPI
    default y

config ZMK_DISPLAY
    default y

config ZMK_SPLIT
    default y

choice ZMK_SPLIT_TRANSPORT
    default ZMK_SPLIT_SERIAL
endchoice

if LVGL

choice LV_COLOR_DEPTH
    default LV_COLOR_DEPTH_1
endchoice

choice ZMK_LV_FONT_DEFAULT_SMALL
    default ZMK_LV_FONT_DEFAULT_SMALL_MONTSERRAT_26
endchoice

endif # LVGL

endif # SHIELD_PIANTOR_MX_LEFT || SHIELD_PIANTOR_MX_RIGHT

if SHIELD_PIANTOR_MX_LEFT

config ZMK_KEYBOARD_NAME
    default "piantor_mx"

config ZMK_USB
    default y

config ZMK_USB_LOGGING
    default y

config ZMK_SPLIT_ROLE_CENTRAL
    default y

endif # SHIELD_PIANTOR_MX_LEFT
```

## app/boards/shields/piantor_mx/Kconfig.shield
```kconfig
# Copyright (c) 2024 The ZMK Contributors
# SPDX-License-Identifier: MIT

config SHIELD_PIANTOR_MX_LEFT
    def_bool $(shields_list_contains,piantor_mx_left)

config SHIELD_PIANTOR_MX_RIGHT
    def_bool $(shields_list_contains,piantor_mx_right)
```
